#include "oled.h"
#include "bsp_gpio.h"
#include "bsp_time.h"
#include "car_config.h"

static const uint8_t font6x8[][6] = {
    {0x00,0x00,0x00,0x00,0x00,0x00}, /* space */
    {0x00,0x00,0x5F,0x00,0x00,0x00}, /* ! */
    {0x00,0x07,0x00,0x07,0x00,0x00}, /* " */
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    {0x61,0x51,0x49,0x45,0x43,0x00}  /* Z */
};

static void i2c_delay(void)
{
    Bsp_DelayUs(2U);
}

static void scl(uint8_t v) { Bsp_GpioWrite(OLED_PORT, OLED_SCL_PIN, v); }
static void sda(uint8_t v) { Bsp_GpioWrite(OLED_PORT, OLED_SDA_PIN, v); }

static void start(void)
{
    sda(1U); scl(1U); i2c_delay();
    sda(0U); i2c_delay();
    scl(0U);
}

static void stop(void)
{
    sda(0U); scl(1U); i2c_delay();
    sda(1U); i2c_delay();
}

static void send_byte(uint8_t data)
{
    uint8_t i;
    for (i = 0U; i < 8U; i++)
    {
        sda((data & 0x80U) ? 1U : 0U);
        scl(1U); i2c_delay();
        scl(0U); i2c_delay();
        data <<= 1;
    }
    sda(1U);
    scl(1U); i2c_delay();
    scl(0U);
}

static void write_cmd(uint8_t cmd)
{
    start();
    send_byte(OLED_ADDR);
    send_byte(0x00U);
    send_byte(cmd);
    stop();
}

static void write_data(uint8_t data)
{
    start();
    send_byte(OLED_ADDR);
    send_byte(0x40U);
    send_byte(data);
    stop();
}

static void set_pos(uint8_t x, uint8_t page)
{
    write_cmd((uint8_t)(0xB0U + page));
    write_cmd((uint8_t)(0x10U | ((x >> 4) & 0x0FU)));
    write_cmd((uint8_t)(x & 0x0FU));
}

void OLED_Init(void)
{
    Bsp_GpioConfig(OLED_PORT, OLED_SCL_PIN, GPIO_MODE_OUT_OD_2MHZ);
    Bsp_GpioConfig(OLED_PORT, OLED_SDA_PIN, GPIO_MODE_OUT_OD_2MHZ);
    scl(1U);
    sda(1U);
    Bsp_DelayMs(80U);

    write_cmd(0xAEU);
    write_cmd(0x20U); write_cmd(0x02U);
    write_cmd(0xB0U);
    write_cmd(0xC8U);
    write_cmd(0x00U);
    write_cmd(0x10U);
    write_cmd(0x40U);
    write_cmd(0x81U); write_cmd(0x7FU);
    write_cmd(0xA1U);
    write_cmd(0xA6U);
    write_cmd(0xA8U); write_cmd(0x3FU);
    write_cmd(0xA4U);
    write_cmd(0xD3U); write_cmd(0x00U);
    write_cmd(0xD5U); write_cmd(0x80U);
    write_cmd(0xD9U); write_cmd(0xF1U);
    write_cmd(0xDAU); write_cmd(0x12U);
    write_cmd(0xDBU); write_cmd(0x40U);
    write_cmd(0x8DU); write_cmd(0x14U);
    write_cmd(0xAFU);
    OLED_Clear();
}

void OLED_Clear(void)
{
    uint8_t page;
    uint8_t x;
    for (page = 0U; page < 8U; page++)
    {
        set_pos(0U, page);
        for (x = 0U; x < 128U; x++)
        {
            write_data(0x00U);
        }
    }
}

void OLED_ShowString(uint8_t x, uint8_t page, const char *str)
{
    uint8_t i;
    set_pos(x, page);
    while (*str && x < 122U)
    {
        char ch = *str++;
        if (ch < ' ' || ch > 'Z')
        {
            ch = ' ';
        }
        for (i = 0U; i < 6U; i++)
        {
            write_data(font6x8[(uint8_t)ch - ' '][i]);
        }
        x = (uint8_t)(x + 6U);
    }
}

void OLED_ShowUInt(uint8_t x, uint8_t page, uint16_t value)
{
    char buf[6];
    uint8_t i = 0U;
    uint8_t j;
    do
    {
        buf[i++] = (char)('0' + (value % 10U));
        value /= 10U;
    } while (value && i < sizeof(buf));
    set_pos(x, page);
    for (j = 0U; j < i; j++)
    {
        char c[2];
        c[0] = buf[i - 1U - j];
        c[1] = 0;
        OLED_ShowString((uint8_t)(x + j * 6U), page, c);
    }
}
